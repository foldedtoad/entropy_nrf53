## CMakeLists.txt
```
#
# Copyright (c) 2020 Nordic Semiconductor
#
# SPDX-License-Identifier: LicenseRef-Nordic-5-Clause
#
cmake_minimum_required(VERSION 3.20.0)

set(BOARD nrf5340dk_nrf5340_cpuapp)

find_package(Zephyr REQUIRED HINTS $ENV{ZEPHYR_BASE})
project(entropy_nrf53_cpuapp)

target_sources(app PRIVATE src/main.c)
target_sources(app PRIVATE src/entropy_ser.c)

target_include_directories(app PRIVATE ../)
target_include_directories(app PRIVATE ../../nrf_rpc_1/include)
target_include_directories(app PRIVATE ../../nrf_rpc_2/include)

set(nrf_rpc_1_base   ${CMAKE_CURRENT_SOURCE_DIR}/../nrf_rpc_1)
set(nrf_rpc_2_base   ${CMAKE_CURRENT_SOURCE_DIR}/../nrf_rpc_2)

add_subdirectory(${nrf_rpc_1_base} build/nrf_rpc_1)
add_subdirectory(${nrf_rpc_2_base} build/nrf_rpc_2)

# zephyr_compile_options(-save-temps)
```

## Kconfig
```
#
#
#

module = APP
module-str = APP

config SUPPORT_APP_RPC
	bool "Support for App RPC"
	default y

config APP_RPC
	bool "Enable App RPC"
	default y
	depends on SUPPORT_APP_RPC
	select NRF_RPC
	select NRF_RPC_CBOR

menu "nRF RPC Libraries"
source "$srctree/../../entropy_nrf53/nrf_rpc_1/Kconfig"
source "$srctree/../../entropy_nrf53/nrf_rpc_2/Kconfig"
endmenu

menu "Zephyr"
source "Kconfig.zephyr"
endmenu
```

## prj.conf
```kconfig
CONFIG_HEAP_MEM_POOL_SIZE=4096

CONFIG_TINYCBOR=y
CONFIG_THREAD_CUSTOM_DATA=y
CONFIG_BOARD_ENABLE_CPUNET=y

CONFIG_LOG=y

# Uncommend to allow better debugging
#CONFIG_NO_OPTIMIZATIONS=y
#CONFIG_DEBUG=y

####################

CONFIG_NRFX_IPC=y

CONFIG_LIBMETAL=y
CONFIG_LIBMETAL_SRC_PATH="libmetal"

CONFIG_OPENAMP=y
CONFIG_OPENAMP_SRC_PATH="open-amp"
CONFIG_OPENAMP_MASTER=y
CONFIG_OPENAMP_SLAVE=y

CONFIG_IPM=y
CONFIG_IPM_NRFX=y
CONFIG_IPM_MSG_CH_0_ENABLE=y
CONFIG_IPM_MSG_CH_1_ENABLE=y
CONFIG_IPM_MSG_CH_0_TX=y
CONFIG_IPM_MSG_CH_1_RX=y

CONFIG_RPMSG_SERVICE=y
CONFIG_RPMSG_SERVICE_MODE_MASTER=y
CONFIG_RPMSG_SERVICE_NUM_ENDPOINTS=2
CONFIG_RPMSG_SERVICE_WORK_QUEUE_STACK_SIZE=2048
CONFIG_RPMSG_SERVICE_INIT_PRIORITY=48
CONFIG_RPMSG_SERVICE_EP_REG_PRIORITY=47
```

## src/main.c
```c
/*
 * Copyright (c) 2020 Nordic Semiconductor ASA
 *
 * SPDX-License-Identifier: LicenseRef-Nordic-5-Clause
 */

#include <zephyr.h>

#include <nrf_rpc.h>

#include "entropy_ser.h"

#include <logging/log.h>
LOG_MODULE_REGISTER(app_main, 3);

#define BUFFER_LENGTH 10

static uint8_t buffer[BUFFER_LENGTH];

static void result_callback(int result, uint8_t *buffer, size_t length)
{
	if (result) {
		LOG_ERR("Entropy remote get failed: %d", result);
		return;
	}

	LOG_HEXDUMP_INF(buffer, length, "entropy_remote_get_async");
}

void main(void)
{
	int err;

	LOG_INF("Entropy sample started [APP Core].");

	err = entropy_remote_init();
	if (err) {
		LOG_ERR("Remote entropy driver initialization failed.");
		return;
	}

	LOG_DBG("Remote init send.");

	while (true) {
		k_sleep(K_MSEC(2000));

		LOG_DBG("entropy_remote_get");
		err = entropy_remote_get(buffer, sizeof(buffer));
		if (err) {
			LOG_ERR("Entropy remote get failed: %d.", err);
			continue;
		}

		LOG_HEXDUMP_INF(buffer, sizeof(buffer), "entropy_remote_get");

		k_sleep(K_MSEC(2000));

		LOG_DBG("entropy_remote_get_inline");
		err = entropy_remote_get_inline(buffer, sizeof(buffer));
		if (err) {
			LOG_ERR("Entropy remote get failed: %d.", err);
			continue;
		}

		LOG_HEXDUMP_INF(buffer, sizeof(buffer), "entropy_remote_get_inline");

		k_sleep(K_MSEC(2000));

		LOG_DBG("entropy_remote_get_async");
		err = entropy_remote_get_async(sizeof(buffer), result_callback);
		if (err) {
			LOG_ERR("Entropy remote get async failed: %d.", err);
			continue;
		}

		k_sleep(K_MSEC(2000));

		LOG_DBG("entropy_remote_get_cbk");
		err = entropy_remote_get_cbk(sizeof(buffer), result_callback);
		if (err) {
			LOG_ERR("Entropy remote get callback failed: %d.", err);
			continue;
		}
	}
}
```

## src/entropy_ser.c
```c
/*
 * Copyright (c) 2020 Nordic Semiconductor ASA
 *
 * SPDX-License-Identifier: LicenseRef-Nordic-5-Clause
 */
#include <errno.h>
#include <init.h>

#include <tinycbor/cbor.h>

#include <nrf_rpc_cbor.h>

#include "../../common_ids.h"

#include <logging/log.h>
LOG_MODULE_REGISTER(app_entropy_ser, 3);

#define CBOR_BUF_SIZE 16


struct entropy_get_result {
	uint8_t *buffer;
	size_t length;
	int result;
};


static void (*result_callback)(int result, uint8_t *buffer, size_t length);


NRF_RPC_GROUP_DEFINE(entropy_group, "nrf_sample_entropy", NULL, NULL, NULL);


void rsp_error_code_handle(CborValue *value, void *handler_data)
{
	CborError cbor_err;

	if (!cbor_value_is_integer(value)) {
		*(int *)handler_data = -NRF_EINVAL;
	}

	cbor_err = cbor_value_get_int(value, (int *)handler_data);
	if (cbor_err != CborNoError) {
		*(int *)handler_data = -NRF_EINVAL;
	}
}


int entropy_remote_init(void)
{
	int result;
	int err;
	struct nrf_rpc_cbor_ctx ctx;

	NRF_RPC_CBOR_ALLOC(ctx, CBOR_BUF_SIZE);

	err = nrf_rpc_cbor_cmd(&entropy_group, RPC_COMMAND_ENTROPY_INIT, &ctx,
			       rsp_error_code_handle, &result);
	if (err < 0) {
		return err;
	}

	return result;
}


static void entropy_get_rsp(CborValue *value, void *handler_data)
{
	size_t buflen;
	CborError cbor_err;
	struct entropy_get_result *result =
		(struct entropy_get_result *)handler_data;

	if (!cbor_value_is_integer(value)) {
		goto cbor_error_exit;
	}

	cbor_err = cbor_value_get_int(value, &result->result);
	if (cbor_err != CborNoError) {
		goto cbor_error_exit;
	}

	cbor_err = cbor_value_advance(value);
	if (cbor_err != CborNoError) {
		goto cbor_error_exit;
	}

	buflen = result->length;
	cbor_err = cbor_value_copy_byte_string(value, result->buffer, &buflen,
					       NULL);
	if (cbor_err != CborNoError || buflen != result->length) {
		goto cbor_error_exit;
	}

	return;

cbor_error_exit:
	result->result = -NRF_EINVAL;
}


int entropy_remote_get(uint8_t *buffer, size_t length)
{
	int err;
	struct nrf_rpc_cbor_ctx ctx;
	struct entropy_get_result result = {
		.buffer = buffer,
		.length = length,
	};

	if (!buffer || length < 1) {
		return -NRF_EINVAL;
	}

	NRF_RPC_CBOR_ALLOC(ctx, CBOR_BUF_SIZE);

	cbor_encode_int(&ctx.encoder, length);

	err = nrf_rpc_cbor_cmd(&entropy_group, RPC_COMMAND_ENTROPY_GET, &ctx,
			       entropy_get_rsp, &result);
	if (err) {
		return -NRF_EINVAL;
	}

	return result.result;
}


int entropy_remote_get_inline(uint8_t *buffer, size_t length)
{
	int err;
	CborError cbor_err;
	struct nrf_rpc_cbor_rsp_ctx ctx;
	int result;
	size_t buflen;

	if (!buffer || length < 1) {
		return -NRF_EINVAL;
	}

	NRF_RPC_CBOR_ALLOC(ctx, CBOR_BUF_SIZE);

	cbor_encode_int(&ctx.encoder, length);

	err = nrf_rpc_cbor_cmd_rsp(&entropy_group, RPC_COMMAND_ENTROPY_GET,
				   &ctx);
	if (err) {
		return -NRF_EINVAL;
	}

	if (!cbor_value_is_integer(&ctx.value)) {
		goto cbor_error_exit;
	}

	cbor_err = cbor_value_get_int(&ctx.value, &result);
	if (cbor_err != CborNoError) {
		goto cbor_error_exit;
	}

	cbor_err = cbor_value_advance(&ctx.value);
	if (cbor_err != CborNoError) {
		goto cbor_error_exit;
	}

	buflen = length;
	cbor_err = cbor_value_copy_byte_string(&ctx.value, buffer, &buflen,
					       NULL);
	if (cbor_err != CborNoError || buflen != length) {
		goto cbor_error_exit;
	}

	nrf_rpc_cbor_decoding_done(&ctx.value);
	return result;

cbor_error_exit:
	nrf_rpc_cbor_decoding_done(&ctx.value);
	return -NRF_EINVAL;
}


int entropy_remote_get_async(uint16_t length, void (*callback)(int result,
							       uint8_t *buffer,
							       size_t length))
{
	int err;
	struct nrf_rpc_cbor_ctx ctx;

	if (length < 1 || callback == NULL) {
		return -NRF_EINVAL;
	}

	result_callback = callback;

	NRF_RPC_CBOR_ALLOC(ctx, CBOR_BUF_SIZE);

	cbor_encode_int(&ctx.encoder, length);

	err = nrf_rpc_cbor_evt(&entropy_group, RPC_EVENT_ENTROPY_GET_ASYNC,
			       &ctx);
	if (err) {
		return -NRF_EINVAL;
	}

	return 0;
}


int entropy_remote_get_cbk(uint16_t length, void (*callback)(int result,
							     uint8_t *buffer,
							     size_t length))
{
	int err;
	int result;
	struct nrf_rpc_cbor_ctx ctx;

	if (length < 1 || callback == NULL) {
		return -NRF_EINVAL;
	}

	result_callback = callback;

	NRF_RPC_CBOR_ALLOC(ctx, CBOR_BUF_SIZE);

	cbor_encode_int(&ctx.encoder, length);

	err = nrf_rpc_cbor_cmd(&entropy_group, RPC_COMMAND_ENTROPY_GET_CBK,
			       &ctx, rsp_error_code_handle, &result);
	if (err) {
		return -NRF_EINVAL;
	}

	return result;
}


static void entropy_get_result_handler(CborValue *value, void *handler_data)
{
	bool is_command = (handler_data != NULL);
	int err_code;
	CborError err;
	size_t length;
	uint8_t buf[32];

	if (result_callback == NULL) {
		nrf_rpc_cbor_decoding_done(value);
		return;
	}

	err = cbor_value_get_int(value, &err_code);
	if (err != CborNoError) {
		goto cbor_error_exit;
	}

	err = cbor_value_advance(value);
	if (err != CborNoError) {
		goto cbor_error_exit;
	}

	length = sizeof(buf);
	err = cbor_value_copy_byte_string(value, buf, &length, NULL);
	if (err != CborNoError) {
		goto cbor_error_exit;
	}

	nrf_rpc_cbor_decoding_done(value);

	result_callback(err_code, buf, length);

	if (is_command) {
		struct nrf_rpc_cbor_ctx ctx;

		NRF_RPC_CBOR_ALLOC(ctx, 0);
		nrf_rpc_cbor_rsp_no_err(&ctx);
	}

	return;

cbor_error_exit:
	nrf_rpc_cbor_decoding_done(value);
	result_callback(-NRF_EINVAL, buf, 0);
}


NRF_RPC_CBOR_CMD_DECODER(entropy_group, entropy_get_cbk_result,
			 RPC_COMMAND_ENTROPY_GET_CBK_RESULT,
			 entropy_get_result_handler, (void *)1);

NRF_RPC_CBOR_EVT_DECODER(entropy_group, entropy_get_async_result,
			 RPC_EVENT_ENTROPY_GET_ASYNC_RESULT,
			 entropy_get_result_handler, NULL);


static void err_handler(const struct nrf_rpc_err_report *report)
{
	LOG_ERR("nRF RPC error %d ocurred. See nRF RPC logs for more details.",
	       report->code);
	k_oops();
}


static int serialization_init(const struct device *dev)
{
	ARG_UNUSED(dev);

	int err;

	LOG_INF("Init begin.");

	err = nrf_rpc_init(err_handler);
	if (err) {
		return -NRF_EINVAL;
	}

	LOG_INF("Init done.");

	return 0;
}


SYS_INIT(serialization_init, POST_KERNEL, CONFIG_APPLICATION_INIT_PRIORITY);
```
